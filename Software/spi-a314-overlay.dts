/dts-v1/;
/plugin/;

/ {
        compatible = "brcm,bcm2835";

        fragment@0 {
                target = <&spidev0>;
                __overlay__ {
                        spi-cs-high;
                };
        };
};